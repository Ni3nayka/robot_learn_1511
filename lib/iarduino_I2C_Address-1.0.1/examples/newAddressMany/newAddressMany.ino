// ПРИМЕР СМЕНЫ АДРЕСОВ НЕСКОЛЬКИХ МОДУЛЕЙ:       // * Строки со звёздочкой являются необязательными.
                                                  //
#include <Wire.h>                                 // * Подключаем библиотеку для работы с аппаратной шиной I2C.
#include <iarduino_I2C_Address.h>                 //   Подключаем библиотеку для работы с адресами модулей линейки I2C-flash.
iarduino_I2C_Address j[]={0xA4,0xA5,0xA6,0xA7};   //   Определяем массив объектов, указав текущие адреса модулей I2C-flash на шине I2C.
                                                  //   Допускается объявить массив без указания адресов, например, iarduino_I2C_Address j[4]; Адреса модулей будут определены автоматически.
void setup(){                                     //
     delay(500);                                  // * Ждём завершение переходных процессов связанных с подачей питания.
     Serial.begin(9600);                          //
     while(!Serial){;}                            // * Ждём завершения инициализации шины UART.
//   Инициируем работу с модулями:                //   Указанные действия можно выполнить в цикле.
     j[0].begin();                                //
     j[1].begin();                                //   Инициализацию можно выполнять с проверкой: if( j[1].begin() ){/*успешно*/;}else{/*провал*/;}
     j[2].begin();                                //
     j[3].begin();                                //
//   Выводим старые адреса модулей на шине I2C:   //   Указанные действия можно выполнить в цикле.
     Serial.println("Найдены модули:");           //
     if(j[0]){ Serial.println(j[0]); }            //   Если модуль с адресом 0xA4 не проинициализирован, то условие if(j[0]) не будет выполнено.
     if(j[1]){ Serial.println(j[1]); }            //   Если модуль с адресом 0xA5 не проинициализирован, то условие if(j[1]) не будет выполнено.
     if(j[2]){ Serial.println(j[2]); }            //   Если модуль с адресом 0xA6 не проинициализирован, то условие if(j[2]) не будет выполнено.
     if(j[3]){ Serial.println(j[3]); }            //   Если модуль с адресом 0xA7 не проинициализирован, то условие if(j[3]) не будет выполнено.
//   Указываем новые адреса модулям:              //   Указанные действия можно выполнить в цикле.
     Serial.println("Меняем адреса модулей...");  //
     j[0]=0x10;                                   //   Важно назначать адреса, которых ещё нет на шине I2C!!!
     j[1]=0x11;                                   //   Успех записи нового адреса можно проверить по результату присвоения:    if( j[1]= 0x11 ){/*успешно*/;}else{/*провал*/;}
     j[2]=0x12;                                   //   Успех записи нового адреса можно проверить после присвоения: j[2]=0x12; if( j[2]==0x12 ){/*успешно*/;}else{/*провал*/;}
     j[3]=0x13;                                   //
//   Выводим адреса модулей на шине I2C:          //   Указанные действия можно выполнить в цикле.
     Serial.println("Новые адреса модулей:");     //
     if(j[0]){ Serial.println(j[0]); }            //
     if(j[1]){ Serial.println(j[1]); }            //
     if(j[2]){ Serial.println(j[2]); }            //
     if(j[3]){ Serial.println(j[3]); }            //
}                                                 //
                                                  //
void loop(){                                      //
}                                                 //
                                                  //
//  ПРИМЕЧАНИЕ:                                   //
//  Если объявить массив объектов без указания    //
//  адресов, например, iarduino_I2C_Address j[4]; //
//  То адреса будут определены автоматически по   //
//  возрастанию. Нулевой элемент массива объектов //
//  будет работать с модулем имеющем наименьший   //
//  адрес.                                        //
//  Если количество устройств на шине меньше чем  //
//  количество элементов массива объектов, то     //
//  «лишние» элементы массива не пройдут инициа-  //
//  лизацию и не пройдут проверку if(j[n]).       //