#include <LiquidCrystal.h>     // Подключаем библиотеку LiquidCrystal для работы с LCD дисплеем
LiquidCrystal lcd(2,3,4,5,6,7);// Создаём объект библиотеки LiquidCrystal, выводы дисплея (RS,E,D4,D5,D6,D7)
const int      PinST = 12;     // Создаём константу с № входа к которому подключён датчик вибраций
      bool     Tilt  = 0;      // Создаём переменную с флагом наклона
      uint32_t TiltTime;       // Создаём переменную для хранения времени последнего изменения наклона
      uint8_t  TiltSum;        // Создаём переменную для подсчёта количества наклонов
      uint8_t  symbol[7][8] = {// Создаём массив из семи символов, для их записи в ОЗУ дисплея
                                  {14,10,10,10,31,17,17,0} /* Д */, {21,21,21,14,21,21,21,0} /* Ж */,
                                  {17,17,19,21,25,17,17,0} /* И */, { 7, 9,17,17,17,17,17,0} /* Л */,
                                  {17,17,17,15, 1, 1,14,0} /* У */, {17,17,17,15, 1, 1, 1,0} /* Ч */,
                                  {21,21,21,21,21,21,31,0} /* Ш */  };
      char*    answer[10]   = {// Создаём массив с ответами на вопросы
                                  "\1A","HET","KOHE\6HO, \1A","KOHE\6HO, HET","\1A, HO HE CPA3\5",
                                  "HE \5BEPEH","BO3MO\2HO","HEBO3MO\2HO","\7\5T\3\7b?",
                                  "H\3 B KOEM C\4\5\6AE"};
void setup(){
    pinMode(PinST, INPUT);     // Конфигурируем вывод PinST как вход
    lcd.begin(16, 2);          // Инициируем работу с LCD дисплеем, указывая количество (столбцов, строк)
    for(int i=0; i<7; i++){lcd.createChar(i+1, symbol[i]);} // Записываем массив символов в ОЗУ дисплея
}

void loop(){
    if(Tilt!=digitalRead(PinST)){  // Если текущее состояние датчика наклона отличается от предыдущего
        if((TiltTime+1000)>millis()){lcd.print(">>"); TiltSum++;}  // Если прошло <1сек. увеличиваем счетчик
        else                        {lcd.setCursor(0,0); lcd.clear(); TiltSum=0;} // иначе обнуляем его
        Tilt=!Tilt; delay(200); TiltTime=millis();  // Сохраняем время и текущее состояние датчика наклона
    }
    if(TiltSum>6){  // Если состояние датчика наклона менялось больше 6 раз, выводим один из ответов
        TiltSum=0; lcd.clear(); lcd.setCursor(0,0); lcd.print(answer[((TiltTime/10)%10)]); delay(5000);
    }
    if((TiltTime+2000)<millis()){  // Если датчик неподвижен более 2 секунд, выводим заставку
        lcd.setCursor(0,0); lcd.print("Magical         ");
        lcd.setCursor(0,1); lcd.print("      Breadboard");
    }
}
