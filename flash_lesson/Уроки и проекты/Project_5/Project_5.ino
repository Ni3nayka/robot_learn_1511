#include <LiquidCrystal.h>             // Подключаем библиотеку LiquidCrystal для работы с LCD дисплеем
#include <Servo.h>                     // Подключаем библиотеку Servo
LiquidCrystal  lcd(2,3,4,5,6,7);       // Создаём объект библиотеки LiquidCrystal, выводы дисплея (RS,E,D4,D5,D6,D7)
Servo          ObjServo;               // Создаём объект библиотеки Servo
const uint8_t  PinKey      = 12;       // Создаём константу с № вывода к которому подключена кнопка
const uint8_t  PinBeep     = 9;        // Создаём константу с № вывода к которому подключён зуммер
const uint8_t  PinServo    = 8;        // Создаём константу с № вывода к которому подключён сервопривод
const uint8_t  PwdAccess[] ={1,2,3,4}; // Создаём массив с паролем из 4 цифр
      uint8_t  PwdInput[]  ={0,0,0,0}; // Создаём массив для хранения 4 цифр вводимого пароля
      uint8_t  Mode        = 102;      // Создаём переменную для хранения текущего режима (0-100: ввод пароля, 100: проверка пароля, 101: открыто, 102: закрыто)
      bool     ChangeMode  = 1;        // Создаём флаг сигнализирующий о смене режима
      bool     PressKey    = 0;        // Создаём флаг сигнализирующий о нажатии на кнопку
      uint32_t PressTime   = 0;        // Создаём переменную для хранения времени последнего нажатия на кнопку
      uint8_t  symbol[7][8]=          {// Создаём массив из семи символов, для их записи в ОЗУ дисплея
                                      {14,10,10,10,31,17,17,0} /* Д */, {14,17, 1, 2, 1,17,14,0} /* З */,
                                      {17,17,19,21,25,17,17,0} /* И */, { 7, 9,17,17,17,17,17,0} /* Л */,
                                      {31,17,17,17,17,17,17,0} /* П */, {17,17,17,29,19,19,29,0} /* Ы */,
                                      {15,17,17,15, 5, 9,17,0} /* Я */  };
//  Массив symbol предназначен для загрузки семи символов ДЗИЛПЫЯ в ОЗУ дисплея, так как в ПЗУ дисплея, нет кириллических символов.
//  Пароль хранится в константном массиве PwdAccess, а вводится с кнопки в массив PwdInput, после чего оба массива сверяются.
//  Размеры этих массивов должны совпадать, поэтому если Вы захотите изменить пароль 1234 на 0123456789, то измените объявление обоих массивов (строки 8 и 9 скетча):
//  const uint8_t PwdAccess[] ={0,1,2,3,4,5,6,7,8,9}; // Создаём массив с паролем из 10 цифр
//        uint8_t PwdInput[]  ={0,0,0,0,0,0,0,0,0,0}; // Создаём массив для хранения 10 цифр вводимого пароля

void setup(){
    pinMode(PinKey,   INPUT );                                                                                   // Конфигурируем вывод PinKey как вход
    pinMode(PinBeep,  OUTPUT);                                                                                   // Конфигурируем вывод PinBeep как выход
    pinMode(PinServo, OUTPUT);                                                                                   // Конфигурируем вывод PinServo как выход
    ObjServo.attach(PinServo);                                                                                   // Определяем вывод PinServo, с которым будет работать объект ObjServo
    lcd.begin(16, 2);                                                                                            // Инициируем работу с LCD дисплеем, указывая количество (столбцов, строк)
    for(int i=0; i<7; i++){lcd.createChar(i+1, symbol[i]);}                                                      // Записываем массив символов в ОЗУ дисплея
    ObjServo.write(0);                                                                                           // Поворачиваем сервопривод в положение 0 градусов (закрываем)
}

void loop(){
    if(digitalRead(PinKey)){                                                                                     // Если нажато кнопка, то ...
      tone(PinBeep, 1000, 100);                                                                                  // Выводим звуковой сигнал с частотой 1000 Гц длительностью 100 мс.
      while(digitalRead(PinKey)){delay(100);}                                                                    // Ждём пока кнопка не будет отпущена и задержкой в 100 мс подавляем дребезг
      PressTime=millis(); PressKey=1;                                                                            // Сохраняем время отпускания кнопки и устанавливаем флаг PressKey (сигнализирующий о нажатии на кнопку)
    }
    if(Mode<100){
//  ЕСЛИ УСТАНОВЛЕН РЕЖИМ 0-99: ВВОД ПАРОЛЯ ...
        if(ChangeMode){ChangeMode=0;                                                                             // Если установлен флаг ChangeMode (произошла смена режима), то ...
            lcd.clear();                                                                                         // Чистим экран
            lcd.setCursor(0,0); lcd.print("BBO\1 \5APO\4\7:");                                                   // Начиная с 0 столбца, 0 строки, выводим текст: ВВОД ПАРОЛЯ
            lcd.setCursor(0,1); for(int i=0; i<sizeof(PwdAccess); i++){lcd.print("*");}                          // Начиная с 0 столбца, 1 строки, выводим столько символов "*", сколько цифр в пароле
        }
        if(PressKey){                                                                                            // Если установлен флаг PressKey (была нажата кнопка), то ...
            PwdInput[Mode]++; if(PwdInput[Mode]>9){PwdInput[Mode]=0;}                                            // Увеличиваем значение вводимой цифры
        }   lcd.setCursor(Mode,1); if(millis()%400<200){lcd.print(PwdInput[Mode]);}else{lcd.print(" ");}         // Выводим вводимую цифру на дисплей, мигая ей через каждые 0,2 секунды
        if((PressTime+2000)<millis()){PressTime=millis();                                                        // Если кнопка не нажималась дольше 2 сек, переходим к след. режиму
            lcd.setCursor(Mode,1); lcd.print(PwdInput[Mode]);                                                    // Выводим введённую цифру на дисплей, не мигая ей
            Mode++; if(Mode>=sizeof(PwdAccess)){Mode=100;}                                                       // Переходим к вводу следующей цифры, или проверки пароля
        }
    }else if(Mode==100){
//  ЕСЛИ УСТАНОВЛЕН РЕЖИМ 100: ПРОВЕРКА ПАРОЛЯ ...
        Mode=101; for(int i=0; i<sizeof(PwdAccess); i++){if(PwdAccess[i]!=PwdInput[i]){Mode=102;}} ChangeMode=1; // Устанавливаем режим 5 (открыто) или 6 (закрыто) и устанавливаем флаг ChangeMode
    }else if(Mode==101){
//  ЕСЛИ УСТАНОВЛЕН РЕЖИМ 101: ОТКРЫТО ...
        if(ChangeMode){ChangeMode=0;                                                                             // Если установлен флаг ChangeMode (произошла смена режима), то ...
            tone(PinBeep, 2000, 1000);                                                                           // Выводим звуковой сигнал с частотой 2000 Гц длительностью 1000 мс.
            lcd.clear();                                                                                         // Чистим экран
            lcd.setCursor(0,0); lcd.print("OTKP\6TO");                                                           // Начиная с 0 столбца, 0 строки, выводим текст: ОТКРЫТО
            ObjServo.write(180);                                                                                 // Поворачиваем сервопривод в положение 180 градусов (открываем)
        }
        if(PressKey){                                                                                            // Если установлен флаг PressKey (была нажата кнопка), то ...
            Mode=102; ChangeMode=1;                                                                              // Устанавливаем режим 102 (закрыто) и устанавливаем флаг ChangeMode
        }
    }else if(Mode==102){
//  ЕСЛИ УСТАНОВЛЕН РЕЖИМ 102: ЗАКРЫТО ...
        if(ChangeMode){ChangeMode=0;                                                                             // Если установлен флаг ChangeMode (произошла смена режима), то ...
            tone(PinBeep, 200, 1000);                                                                            // Выводим звуковой сигнал с частотой 200 Гц длительностью 1000 мс.
            lcd.clear();                                                                                         // Чистим экран
            lcd.setCursor(0,0); lcd.print("\2AKP\6TO");                                                          // Начиная с 0 столбца, 0 строки, выводим текст: ЗАКРЫТО
            delay(2000);                                                                                         // Приостанавливаем выполнение программы перед закрытием сервопривода
            ObjServo.write(0);                                                                                   // Поворачиваем сервопривод в положение 0 градусов (закрываем)
            lcd.setCursor(0,1); lcd.print("BBE\1\3TE \5APO\4b");                                                 // Начиная с 0 столбца, 1 строки, выводим текст: ВВЕДИТЕ ПАРОЛЬ
        }
        if(PressKey){                                                                                            // Если установлен флаг PressKey (была нажата кнопка), то ...
            for(int i=0; i<sizeof(PwdAccess); i++){PwdInput[i]=0;}                                               // Обнуляем элементы массива PwdInput
            Mode=0; ChangeMode=1;                                                                                // Устанавливаем режим 0 (ввод 1 цифры пароля) и устанавливаем флаг ChangeMode
        }
    }
    PressKey=0;                                                                                                  // Сбрасываем флаг PressKey (сигнализирующий о нажатии на кнопку)
}
